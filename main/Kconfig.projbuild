## main/Kconfig.projbuild
```kconfig
menu "PS5 Linux Wake"

choice PSWAKE_DEVICE_PROFILE
    prompt "Device profile"
    default PSWAKE_DEVICE_TDISPLAY

config PSWAKE_DEVICE_TDISPLAY
    bool "LilyGO/TTGO T-Display ESP32"

config PSWAKE_DEVICE_DEVKITC
    bool "ESP32-DevKitC without display"

endchoice

config PSWAKE_HAS_DISPLAY
    bool
    default y if PSWAKE_DEVICE_TDISPLAY
    default n if PSWAKE_DEVICE_DEVKITC

config PSWAKE_HAS_BUTTONS
    bool
    default y if PSWAKE_DEVICE_TDISPLAY
    default n if PSWAKE_DEVICE_DEVKITC

config PSWAKE_WIFI_SSID
    string "WiFi SSID"
    default ""
    help
        LAN SSID used to receive the PS5 Linux loader UDP beacon.

config PSWAKE_WIFI_PASSWORD
    string "WiFi password"
    default ""

config PSWAKE_AP_FALLBACK
    bool "Enable AP fallback when WiFi SSID is empty or STA fails"
    default y

config PSWAKE_AP_SSID
    string "Fallback AP SSID"
    default "pswake-esp32"

config PSWAKE_AP_PASSWORD
    string "Fallback AP password"
    default "pswake1234"

config PSWAKE_PROFILE_NAME
    string "Default profile name"
    default "ps5"

config PSWAKE_TOKEN
    string "Default profile token"
    default "ps5-linux"

config PSWAKE_PS5_BT_ADDR
    string "PlayStation Bluetooth address"
    default "00:00:00:00:00:00"

config PSWAKE_CONTROLLER_BT_ADDR
    string "Paired controller Bluetooth address"
    default "00:00:00:00:00:00"

config PSWAKE_UDP_PORT
    int "UDP beacon listen port"
    default 9755

config PSWAKE_PING_INTERVAL_MS
    int "Ping interval while armed"
    default 2000

config PSWAKE_PING_TIMEOUT_MS
    int "Rest-mode ping timeout"
    default 1000

config PSWAKE_ARMED_STABLE_PINGS
    int "Successful pings required before rest detection"
    default 2

config PSWAKE_REST_SETTLE_MS
    int "Rest-mode settle delay before BT wake"
    default 0

config PSWAKE_WAKE_RETRIES
    int "BT wake retries"
    default 1

config PSWAKE_BTN_WAKE_GPIO
    int "Wake/manual arm button GPIO (-1 disables)"
    default 0 if PSWAKE_DEVICE_TDISPLAY
    default -1 if PSWAKE_DEVICE_DEVKITC

config PSWAKE_BTN_CANCEL_GPIO
    int "Cancel button GPIO (-1 disables)"
    default 35 if PSWAKE_DEVICE_TDISPLAY
    default -1 if PSWAKE_DEVICE_DEVKITC

config PSWAKE_LCD_MOSI
    int "T-Display LCD MOSI GPIO"
    depends on PSWAKE_HAS_DISPLAY
    default 19

config PSWAKE_LCD_SCLK
    int "T-Display LCD SCLK GPIO"
    depends on PSWAKE_HAS_DISPLAY
    default 18

config PSWAKE_LCD_CS
    int "T-Display LCD CS GPIO"
    depends on PSWAKE_HAS_DISPLAY
    default 5

config PSWAKE_LCD_DC
    int "T-Display LCD DC GPIO"
    depends on PSWAKE_HAS_DISPLAY
    default 16

config PSWAKE_LCD_RST
    int "T-Display LCD RST GPIO"
    depends on PSWAKE_HAS_DISPLAY
    default 23

config PSWAKE_LCD_BL
    int "T-Display LCD backlight GPIO"
    depends on PSWAKE_HAS_DISPLAY
    default 4

config PSWAKE_LCD_BRIGHTNESS
    int "T-Display LCD backlight brightness percent"
    depends on PSWAKE_HAS_DISPLAY
    range 0 100
    default 70

config PSWAKE_LCD_SWAP_XY
    bool "Swap LCD X/Y axes"
    depends on PSWAKE_HAS_DISPLAY
    default n

config PSWAKE_LCD_MIRROR_X
    bool "Mirror LCD X axis"
    depends on PSWAKE_HAS_DISPLAY
    default y

config PSWAKE_LCD_MIRROR_Y
    bool "Mirror LCD Y axis"
    depends on PSWAKE_HAS_DISPLAY
    default y

config PSWAKE_LCD_X_GAP
    int "LCD X gap/offset"
    depends on PSWAKE_HAS_DISPLAY
    default 53

config PSWAKE_LCD_Y_GAP
    int "LCD Y gap/offset"
    depends on PSWAKE_HAS_DISPLAY
    default 40

endmenu
```

## sdkconfig.defaults
```kconfig
CONFIG_IDF_TARGET="esp32"
CONFIG_BT_ENABLED=y
CONFIG_BTDM_CTRL_MODE_BLE_ONLY=n
CONFIG_BTDM_CTRL_MODE_BR_EDR_ONLY=y
CONFIG_BTDM_CTRL_MODE_BTDM=n
CONFIG_BT_BLUEDROID_ENABLED=n
CONFIG_BT_CONTROLLER_ONLY=y
CONFIG_BT_CONTROLLER_ENABLED=y
CONFIG_BTDM_CTRL_BR_EDR_MAX_ACL_CONN=1
CONFIG_BTDM_CTRL_BR_EDR_MAX_SYNC_CONN=0
CONFIG_BTDM_CTRL_MODEM_SLEEP=n
CONFIG_ESP_MAIN_TASK_STACK_SIZE=8192
CONFIG_FREERTOS_HZ=1000
```
